/*
 * Copyright 2019 MYiR Devices
 */
 
#include "myb-fsl-imx8mm-hontron-7.dts"

/{
     display-subsystem {                                                                                
         status = "okay";
	};
};

